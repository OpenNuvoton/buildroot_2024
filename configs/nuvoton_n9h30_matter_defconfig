## configs/nuvoton_n9h30_matter_defconfig
```kconfig
BR2_arm=y
BR2_TOOLCHAIN_BUILDROOT_VENDOR="nuvoton"
BR2_PACKAGE_GLIBC_UTILS=y
BR2_TOOLCHAIN_BUILDROOT_CXX=y
BR2_PACKAGE_HOST_GDB=y
BR2_SVN="svn"
BR2_BACKUP_SITE="http://sources.buildroot.net"
BR2_CPAN_MIRROR="http://cpan.metacpan.org"
BR2_OPTIMIZE_S=y
BR2_SHARED_STATIC_LIBS=y
BR2_SSP_NONE=y
BR2_FORTIFY_SOURCE_NONE=y
BR2_ROOTFS_DEVICE_CREATION_DYNAMIC_MDEV=y
BR2_TARGET_GENERIC_GETTY_BAUDRATE_115200=y
BR2_ROOTFS_POST_BUILD_SCRIPT="board/nuvoton/nuc9x0/install_rootfs_matter.sh"
BR2_LINUX_KERNEL=y
BR2_LINUX_KERNEL_CUSTOM_TARBALL=y
BR2_LINUX_KERNEL_CUSTOM_TARBALL_LOCATION="$(call github,OpenNuvoton,NUC970-linux-5.10.y,master)/NUC970-linux-5.10.y-master.tar.gz"
BR2_LINUX_KERNEL_DEFCONFIG="nuc972"
BR2_LINUX_KERNEL_UIMAGE=y
BR2_PACKAGE_BZIP2=y
BR2_PACKAGE_ZIP=y
BR2_PACKAGE_GETTEXT=y
BR2_PACKAGE_RNG_TOOLS=y
BR2_PACKAGE_LIBOPENSSL_BIN=y
BR2_PACKAGE_LIBOPENSSL_ENGINES=y
BR2_PACKAGE_LIBSYSFS=y
BR2_PACKAGE_LIBNL=y
BR2_PACKAGE_LIBGLIB2=y
BR2_PACKAGE_NCURSES=y
BR2_PACKAGE_PCRE=y
BR2_PACKAGE_PCRE_UCP=y
BR2_PACKAGE_NETPLUG=y
BR2_PACKAGE_NTP=y
BR2_PACKAGE_NTP_SNTP=y
BR2_PACKAGE_NTP_NTPDATE=y
BR2_PACKAGE_PPPD=y
BR2_TARGET_ROOTFS_INITRAMFS=y
BR2_TARGET_UBOOT=y
BR2_TARGET_UBOOT_BUILD_SYSTEM_KCONFIG=y
BR2_TARGET_UBOOT_CUSTOM_TARBALL=y
BR2_TARGET_UBOOT_CUSTOM_TARBALL_LOCATION="$(call github,OpenNuvoton,NUC970_U-Boot_v2016.11,master)/NUC970_U-Boot_v2016.11-master.tar.gz"
BR2_TARGET_UBOOT_BOARD_DEFCONFIG="n9h30_matter"
```

## configs/nuvoton_nuc980_ncsi_defconfig
```kconfig
BR2_arm=y
BR2_TOOLCHAIN_BUILDROOT_VENDOR="nuvoton"
BR2_TOOLCHAIN_BUILDROOT_CXX=y
BR2_SVN="svn"
BR2_SHARED_STATIC_LIBS=y
BR2_ROOTFS_DEVICE_CREATION_DYNAMIC_MDEV=y
BR2_TARGET_GENERIC_GETTY_BAUDRATE_115200=y
BR2_ROOTFS_POST_BUILD_SCRIPT="board/nuvoton/nuc9x0/install_rootfs_ncsi.sh"
BR2_LINUX_KERNEL=y
BR2_LINUX_KERNEL_CUSTOM_TARBALL=y
BR2_LINUX_KERNEL_CUSTOM_TARBALL_LOCATION="$(call github,OpenNuvoton,NUC980-linux-5.10.y,master)/NUC980-linux-5.10.y-master.tar.gz"
BR2_LINUX_KERNEL_DEFCONFIG="nuc980"
BR2_LINUX_KERNEL_UIMAGE=y
BR2_PACKAGE_RNG_TOOLS=y
BR2_PACKAGE_LIBNL=y
BR2_PACKAGE_NCURSES=y
BR2_PACKAGE_NETPLUG=y
BR2_PACKAGE_XXHASH=y
BR2_PACKAGE_NCSI_NETLINK=y
BR2_TARGET_ROOTFS_INITRAMFS=y
BR2_TARGET_UBOOT=y
BR2_TARGET_UBOOT_BUILD_SYSTEM_KCONFIG=y
BR2_TARGET_UBOOT_CUSTOM_TARBALL=y
BR2_TARGET_UBOOT_CUSTOM_TARBALL_LOCATION="$(call github,OpenNuvoton,NUC970_U-Boot_v2016.11,master)/NUC970_U-Boot_v2016.11-master.tar.gz"
BR2_TARGET_UBOOT_BOARD_DEFCONFIG="nuc980_chili"
BR2_PACKAGE_HOST_ENVIRONMENT_SETUP=y
```

## package/airplay/Config.in
```kconfig
config BR2_PACKAGE_AIRPLAY
	bool "airplay"
	select BR2_PACKAGE_HOST_CMAKE
	select BR2_PACKAGE_LIBPLIST
	select BR2_PACKAGE_AVAHI
	select BR2_PACKAGE_LIBCAP
        select BR2_PACKAGE_LIBCAP_TOOLS
	select BR2_PACKAGE_AVAHI_DAEMON
	select BR2_PACKAGE_AVAHI_AUTOIPD
	select BR2_PACKAGE_AVAHI_LIBDNSSD_COMPATIBILITY
	select BR2_PACKAGE_ALSA_UTILS
	select BR2_PACKAGE_ALSA_UTILS_ALSACTL
	select BR2_PACKAGE_ALSA_UTILS_ALSAMIXER
	select BR2_PACKAGE_ALSA_UTILS_APLAY
	select BR2_PACKAGE_GSTREAMER1
	select BR2_PACKAGE_GST1_PLUGINS_BASE
	select BR2_PACKAGE_GST1_PLUGINS_BASE_PLUGIN_ALSA
	select BR2_PACKAGE_GST1_PLUGINS_BASE_PLUGIN_AUDIOCONVERT
	select BR2_PACKAGE_GST1_PLUGINS_BASE_PLUGIN_AUDIORESAMPLE
	select BR2_PACKAGE_GST1_PLUGINS_BASE_PLUGIN_APP
	select BR2_PACKAGE_GST1_PLUGINS_BASE_PLUGIN_PLAYBACK
	select BR2_PACKAGE_GST1_PLUGINS_BASE_PLUGIN_VIDEOCONVERTSCALE
	select BR2_PACKAGE_GST1_PLUGINS_BASE_PLUGIN_VOLUME
	select BR2_PACKAGE_GST1_PLUGINS_BAD
	select BR2_PACKAGE_GST1_PLUGINS_BAD_PLUGIN_FBDEV
	select BR2_PACKAGE_GST1_PLUGINS_BAD_PLUGIN_FDK_AAC
	select BR2_PACKAGE_GST1_PLUGINS_BAD_PLUGIN_SDP
	select BR2_ROOTFS_DEVICE_CREATION_DYNAMIC_EUDEV
	select BR2_PACKAGE_GST1_PLUGINS_BAD_PLUGIN_V4L2CODECS
	select BR2_PACKAGE_GST1_PLUGINS_BAD_PLUGIN_VIDEOPARSERS
	select BR2_PACKAGE_GST1_PLUGINS_GOOD
	select BR2_PACKAGE_GST1_PLUGINS_GOOD_PLUGIN_AUTODETECT
	select BR2_PACKAGE_GST1_PLUGINS_GOOD_PLUGIN_DEBUGUTILS
	select BR2_PACKAGE_GST1_PLUGINS_GOOD_PLUGIN_LEVEL
	select BR2_PACKAGE_GST1_PLUGINS_GOOD_PLUGIN_V4L2
	select BR2_PACKAGE_GST1_PLUGINS_GOOD_PLUGIN_V4L2_PROBE
	select BR2_PACKAGE_LIBPNG
	select BR2_PACKAGE_LIBDRM
	select BR2_PACKAGE_FONTCONFIG
	select BR2_PACKAGE_GST1_LIBAV
	select BR2_PACKAGE_OPENSSL
	select BR2_PACKAGE_LIBOPENSSL
```

## package/lvgl/Config.in
```kconfig
config BR2_PACKAGE_LVGL
        bool "Lvgl"
	depends on !BR2_PACKAGE_WESTON
        select BR2_PACKAGE_HOST_CMAKE

if BR2_PACKAGE_LVGL
        if BR2_PACKAGE_WESTON
                config BR2_PACKAGE_LVGL_WAYLAND
                        bool "built as a Wayland client"
			depends on BR2_PACKAGE_WESTON
                        select BR2_PACKAGE_LVGL_WAYLAND_CLIENT
        endif

	config BR2_PACKAGE_LVGL_TOUCHSCREEN
		bool "built with touchscreen support"

	if BR2_PACKAGE_LVGL_TOUCHSCREEN
		choice
        	prompt "default touchscreen type"
			config BR2_PACKAGE_LVGL_DEFAULT_CAPACITIVE_TOUCHSCREEN
        			bool "capacitive"
        			select BR2_PACKAGE_LVGL_CAPACITIVE_TOUCHSCREEN
			config BR2_PACKAGE_LVGL_DEFAULT_RESISTIVE_TOUCHSCREEN
        			bool "resistive"
        			select BR2_PACKAGE_LVGL_RESISTIVE_TOUCHSCREEN
				select BR2_PACKAGE_TSLIB
		endchoice

	endif
endif
```

## package/ncsi-netlink/Config.in
```kconfig
config BR2_PACKAGE_NCSI_NETLINK_ARCH_SUPPORTS
	bool
	default y if BR2_arm
	default y if BR2_aarch64

config BR2_PACKAGE_NCSI_NETLINK
	bool "ncsi-netlink"
	depends on BR2_PACKAGE_NCSI_NETLINK_ARCH_SUPPORTS
	depends on !BR2_STATIC_LIBS
	depends on BR2_PACKAGE_LIBNL
	help
	  A simple command line utility to interact with NCSI over Netlink.
	  This uses the libnl library to talk Netlink. The Makefile assumes 
	  cross-compiling against a shared libnl library specified via LIBNL_INCDIR and LIBNL_LIBDIR, eg:

	  https://github.com/sammj/ncsi-netlink 
```

## package/nu-lvgl/Config.in
```kconfig
config BR2_PACKAGE_NU_LVGL
        bool "lvgl 8.3.0 with Wayland modified by Nuvoton"
	depends on BR2_PACKAGE_WESTON
        select BR2_PACKAGE_HOST_CMAKE
```

## package/nvt-ma35/Config.in.host
```kconfig
menuconfig BR2_PACKAGE_NUVOTON_MA35
	bool "host nuvoton MA35 series libraries"
	depends on BR2_arm || BR2_aarch64
	help
	  Those packages provide some hardware tools for Nutoton 
	  MA35 series platforms.

if BR2_PACKAGE_NUVOTON_MA35 && BR2_NUVOTON_MA35D1
source "package/nvt-ma35/m4-bsp/Config.in.host"
source "package/nvt-ma35/gcc-arm-none-eabi/Config.in.host"
source "package/nvt-ma35/nu-eclipse/Config.in.host"
endif
```
