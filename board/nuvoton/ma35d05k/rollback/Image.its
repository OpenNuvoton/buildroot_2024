## board/nuvoton/ma35d05k/rollback/Image.its
```
/dts-v1/;

/ {
	description = "MA35 FIT image for slot0";
	#address-cells = <1>;

	images {
		kernel-1 {
			description = "Linux kernel for slot0";
			data = /incbin/("Image");
			type = "kernel";
			arch = "arm64";
			os = "linux";
			compression = "none";
			load = <0x80200000>;
			entry = <0x80200000>;
			image-version = LINUX_VERSION;
			hash-1 {
				algo = "sha256";
			};
		};

		fdt-1 {
			description = "Device tree for slot0";
			data = /incbin/("Image.dtb");
			type = "flat_dt";
			arch = "arm64";
			compression = "none";
			hash-1 {
				algo = "sha256";
			};
		};
	};

	configurations {
		default = "conf-1";

		conf-1 {
			description = "Boot slot0";
			kernel = "kernel-1";
			fdt = "fdt-1";
			signature {
				algo = "sha256,rsa2048";
				key-name-hint = "dev";
				sign-images = "fdt", "kernel";
			};
		};
	};
};
```

## boot/ma35d1-secureboot/Config.in
```kconfig
config BR2_ANTI_ROLLBACK_AB_BOOT
	bool "Enable A/B boot and Anti-Rollback"
	select BR2_TARGET_MA35D1_SECURE_BOOT if BR2_NUVOTON_MA35D1
	select BR2_TARGET_MA35D0_SECURE_BOOT if BR2_NUVOTON_MA35D0
	select BR2_TARGET_MA35H0_SECURE_BOOT if BR2_NUVOTON_MA35H0
	select BR2_TARGET_OTP_ANTI_ROLLBACK
	help
	  Enable dual-slot A/B boot and rollback support.

	  The system keeps two bootable slots, A and B.
	  Normally the active slot is booted first.
	  If booting or validation of the active slot fails,
	  the boot flow can fall back to the other slot.

	  This is typically used for safe firmware update and recovery.

if BR2_ANTI_ROLLBACK_AB_BOOT

menu "A/B Boot & Anti-Rollback Settings"

config BR2_TARGET_MA35_UBOOT_MTDPARTS_AB
	string "A/B mtdparts"
	default "3m(uboot),768k(uboot-env),256k(device-tree),24m(kernel),3m(uboot_b),768k(uboot-env_b),256k(device-tree_b),24m(kernel_b),100m(rootfs)"
	help
	  U-Boot A/B mtdparts layout.

config BR2_TARGET_OTP_ANTI_ROLLBACK
        bool "MA35 OTP Anti-Rollback Protection"
	default y
        help
		  Enable BL2 firmware anti-rollback protection based on the MA35
		  OTP secure-region fuse counter.

		  When enabled, BL2 compares its build-time firmware version
		  counter (MA35D1_BL2_FW_VERSION_COUNT) against the counter
		  recorded in OTP fuses at boot time, and blows additional OTP
		  fuses to record the current version. Booting an older
		  (rolled-back) BL2 image will then be rejected.

		  Note: OTP fuses can only be blown (0 -> 1), never reset. Each
		  firmware version bump permanently consumes part of a limited,
		  one-time budget (704 bits over the life of the chip). Only
		  enable this if your product requires anti-rollback protection
		  and you understand this limitation.

		  Currently supported: MA35D1, MA35D05K.
		  Not yet supported: MA35D0, MA35H0.

		  Default: disabled (n).

config BR2_MA35_ARB_LINUX_VER
	int "Linux Anti-Rollback Version"
	default 0

config BR2_TARGET_MA35_ARB_BL2_VER
	int "BL2 Anti-Rollback Version"
	default 0

config BR2_TARGET_MA35_ARB_BL31_VER
	int "BL31 Anti-Rollback Version"
	default 0

endmenu
endif

if	BR2_NUVOTON_MA35D1

config BR2_TARGET_MA35D1_BOOT_SPACE
	int "MA35 Boot Space(KiB)"
	default "65536"
	help
	  Reserved space form MMC/SD

config BR2_TARGET_MA35D1_SECURE_BOOT
	bool "MA35 Secure Boot"
	help
	  MA35 Secure Boot is a first level bootloader for the MA35
	  devices.

if	BR2_TARGET_MA35D1_SECURE_BOOT

config BR2_TARGET_MA35D1_AES_KEY
	string "AES Key"
	default "0A0BC81E5AFBF836C5E0CFBEA12C1E269A2EBC3B0B6EC39EEE1C7142F760EBC4"
	help
	  AES Key

config BR2_TARGET_MA35D1_ECDSA_KEY
	string "ECDSA Key"
	default "8F1571E9975006A545DF854264F7B18934B5CB2EE619E66DBC0FBEA52C71C919"
	help
          ECDSA Key
endif
endif

if	BR2_NUVOTON_MA35D0
config BR2_TARGET_MA35D0_BOOT_SPACE
        int "MA35D0 Boot Space(KiB)"
	default "32768"
        help
          Reserved space form MMC/SD 

config BR2_TARGET_MA35D0_SECURE_BOOT
	bool "MA35D0 Secure Boot"
	help
	  MA35D0 Secure Boot is a first level bootloader for the MA35D1
	  devices.

if	BR2_TARGET_MA35D0_SECURE_BOOT

config BR2_TARGET_MA35D0_AES_KEY
	string "AES Key"
	default "0A0BC81E5AFBF836C5E0CFBEA12C1E269A2EBC3B0B6EC39EEE1C7142F760EBC4"
	help
	  AES Key

config BR2_TARGET_MA35D0_ECDSA_KEY
	string "ECDSA Key"
	default "8F1571E9975006A545DF854264F7B18934B5CB2EE619E66DBC0FBEA52C71C919"
	help
          ECDSA Key
endif
endif

if	BR2_NUVOTON_MA35H0
config BR2_TARGET_MA35H0_BOOT_SPACE
        int "MA35H0 Boot Space(KiB)"
	default "32768"
        help
          Reserved space form MMC/SD 

config BR2_TARGET_MA35H0_SECURE_BOOT
	bool "MA35H0 Secure Boot"
	help
	  MA35H0 Secure Boot is a first level bootloader for the MA35D1
	  devices.

if	BR2_TARGET_MA35H0_SECURE_BOOT

config BR2_TARGET_MA35H0_AES_KEY
	string "AES Key"
	default "0A0BC81E5AFBF836C5E0CFBEA12C1E269A2EBC3B0B6EC39EEE1C7142F760EBC4"
	help
	  AES Key

config BR2_TARGET_MA35H0_ECDSA_KEY
	string "ECDSA Key"
	default "8F1571E9975006A545DF854264F7B18934B5CB2EE619E66DBC0FBEA52C71C919"
	help
          ECDSA Key
endif
endif
```

## package/libetna2d/Config.in
```kconfig
config BR2_PACKAGE_LIBETNA2D
	bool "libetna2d"
	select BR2_PACKAGE_LIBDRM
	select BR2_PACKAGE_LIBDRM_ETNAVIV
	help
	  Userspace HAL for the Vivante GC520 2D GPU (Nuvoton MA35D1):
	  an opaque C API wrapping the GC520 Drawing Engine's
	  bitblt / stretchblt / premultiplied-alpha-blend commands on
	  top of libdrm_etnaviv, plus KMS scanout helpers.

	  Used by the etnaviv2d Qt5 QPA plugin (qt5-etnaviv2d-qpa) and
	  by the vendor 2D-acceleration test/benchmark tools.
```

## package/nu-hmi-controller/Config.in
```kconfig
config BR2_PACKAGE_NU_HMI_CONTROLLER
	bool "nu-hmi-controller"
	depends on BR2_PACKAGE_WESTON
	depends on BR2_PACKAGE_WESTON_SHELL_IVI
	help
	  ivi-shell HMI controller plugin for Weston: assigns
	  launch-order-independent layer IDs and z-order to ivi-shell
	  client surfaces at runtime (instead of ivi-shell's default
	  launch-order stacking).

	  Loaded by Weston via weston.ini's [core] modules= line;
	  configured via [nuvoton-layer] sections in weston.ini.
```
